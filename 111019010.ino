
byte btn;
int l;
byte bt, i, j, k, p[7]={13,12,11,10,9,8,7};
byte cn[16][7]={
  {0, 0, 0, 0, 0, 0, 1},
  {1, 0, 0, 1, 1, 1, 1},
  {0, 0, 1, 0, 0, 1, 0},
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  {0, 1, 1, 1, 0, 0, 0},
};

void setup()
{
  for(i=0;i<7;i++){
    pinMode(p[i],OUTPUT);
  }
  pinMode(6,INPUT_PULLUP);
}

void loop()
{
  for(i=0;i<16;i++){
    for(l=0;l<1000;l++){
      bt = digitalRead(6);
      if(bt == HIGH){
        for(j=0;j<7;j++){
          digitalWrite(p[j],cn[i][j]);
        }
      }
      else {
        for(k=0;k<7;k++){
          digitalWrite(p[k],1);
        }
      }
      delay(1);
    }
  }
}